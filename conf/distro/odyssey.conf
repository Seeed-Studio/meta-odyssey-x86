## conf/distro/odyssey.conf
```bitbake
require conf/distro/poky.conf

DISTRO_FEATURES:append = " systemd"
DISTRO_FEATURES:remove = "x11 wayland vulkan pulseaudio nfc vfat largefile opengl ptest multiarch gobject-introspection-data"
DISTRO_FEATURES_BACKFILL_CONSIDERED = "sysvinit"
VIRTUAL-RUNTIME_init_manager = "systemd"
VIRTUAL-RUNTIME_initscripts = ""
```

## conf/layer.conf
```bitbake
# We have a conf and classes directory, add to BBPATH
BBPATH .= ":${LAYERDIR}"

# We have a recipes-* directories, add to BBFILES
BBFILES += "${LAYERDIR}/recipes-*/*/*.bb \
	${LAYERDIR}/recipes-*/*/*.bbappend"

BBFILE_COLLECTIONS += "odyssey-x86"
BBFILE_PATTERN_odyssey-x86 = "^${LAYERDIR}/"
BBFILE_PRIORITY_odyssey-x86 = "6"

LAYERDEPENDS_odyssey-x86 = "intel"

LAYERSERIES_COMPAT_odyssey-x86 = "dunfell"
```

## conf/machine/odyssey-x86-mender.conf
```bitbake
#@TYPE: Machine
#@NAME: odyssey-x86
#@DESCRIPTION: Machine configuration for Odyssey X86 systems

require conf/machine/intel-corei7-64.conf

WKS_FILE = "systemd-bootdisk-initrd-mender.wks"

WKS_FILE_DEPENDS:append = " acpi-tables"

# Increase INITRAMFS_MAXSIZE to 384 MiB to cover initramfs-kerneltest-full
# image.
INITRAMFS_MAXSIZE = "393216"

INHERIT += "mender-full"

MENDER_ARTIFACT_NAME = "release-1"
DISTRO_FEATURES:append = " systemd"
VIRTUAL-RUNTIME_init_manager = "systemd"
DISTRO_FEATURES_BACKFILL_CONSIDERED = "sysvinit"
VIRTUAL-RUNTIME_initscripts = ""
MENDER_STORAGE_TOTAL_SIZE_MB_DEFAULT = "4096"
MENDER_BOOT_PART_SIZE_MB = "64"
# By default MENDER_DATA_PART_SIZE_MB=128MB and it will try to resize 
# the partition on first boot to the full size of the remaining space
MENDER_IMAGE_BOOTLOADER_FILE = "wic-initrd"

IMAGE_FEATURES:append = " ssh-server-openssh"

CORE_IMAGE_EXTRA_INSTALL += "acpica acpitool acpi-tables"

DISTRO_FEATURES:remove = "x11 wayland vulkan pulseaudio nfc vfat largefile opengl ptest multiarch gobject-introspection-data"
```

## conf/machine/odyssey-x86.conf
```bitbake
#@TYPE: Machine
#@NAME: odyssey-x86
#@DESCRIPTION: Machine configuration for Odyssey X86 systems

require conf/machine/intel-corei7-64.conf

WKS_FILE = "systemd-bootdisk-initrd.wks"

WKS_FILE_DEPENDS:append = " acpi-tables"

# Increase INITRAMFS_MAXSIZE to 384 MiB to cover initramfs-kerneltest-full
# image.  
INITRAMFS_MAXSIZE = "393216"

# Temporary fix to have a non-mender build working.
MENDER_EFI_LOADER = "ovmf"
```
